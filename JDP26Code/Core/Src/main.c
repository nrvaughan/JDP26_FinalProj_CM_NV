/******************************************************************************
* Project: JDP26 DIY DJ Deck
* File: main.c
*
* Student Name: Nick Vaughan
* Team Members: Colin Medeiros
*
* Course: ECE 304 – Junior Design Project (JDP26)
* Instructor: Prof. Baird Soules
*
* Date: May 6, 2026
*
* Description:
* This program runs on a NUCLEO STM32F303RE microcontroller, utilizing its ADC, DAC, timers, USART, and GPIO to mix audio from microphone and aux inputs.
* It reads audio from both of these inputs using ADC with DMA, mixes them together, and outputs the result through the DAC.
* The mixing can be controlled through a rotary encoder that adjusts the duty cycle of two PWM signals, and there is a knife switch that allows for a software mute when closed.
* 
* Hardware:
* - Microcontroller: Nucleo STM32F303RE
* - Key components: SparkFun Electret Microphone Breakout, Adafruit PAM8302A 2.5W Class D Amplifier, 4Ω 3W Speaker, 10kΩ potentiometer,
* 20-step rotary encoder, SPST knife switch, BESIGN Isolation Transformer, Sallen-Key LPF with octocouplers
*
* Notes:
* The code for ADC, DAC, DMA, timers, USART, and GPIO initialization is generated by STM32CubeMX, all functions generated by CubeMX are marked as so.
* Github Repository with all needed files: [link]!!!!!!!!!!!!!!!!!!!!!!!!

  * Copyright (c) 2026 STMicroelectronics.
  * All rights reserved.
******************************************************************************/



/* Includes ------------------------------------------------------------------*/
#include "main.h"
#include "adc.h"
#include "dac.h"
#include "dma.h"
#include "tim.h"
#include "usart.h"
#include "gpio.h"


/* Private variables ---------------------------------------------------------*/

/* USER CODE BEGIN PV */
#define ADC_BUF_LEN 512
#define ADC_MID     2048

uint16_t adcBuffer[ADC_BUF_LEN];
volatile uint8_t adcHalfReady = 0;
volatile uint8_t adcFullReady = 0;
volatile uint32_t halfCount = 0;
volatile uint32_t fullCount = 0;

int pwm1Dutys[16] = {39, 44, 50, 59, 71, 88, 112, 147, 195, 270, 372, 525, 750, 1100, 1625, 2475};
int pwm2Dutys[16] = {55, 60, 67, 76, 90, 108, 134, 172, 225, 302, 417, 585, 830, 1200, 1749, 2630};

int freqInd = 7;

/* USER CODE END PV */

/* Private function prototypes -----------------------------------------------*/
void SystemClock_Config(void);

/* Private user code ---------------------------------------------------------*/

int main(void)
{

  /* MCU Configuration--------------------------------------------------------*/

  /* Reset of all peripherals, Initializes the Flash interface and the Systick. */
  HAL_Init();


  /* Configure the system clock */
  SystemClock_Config();

  /* Initialize all configured peripherals */
  MX_GPIO_Init();
  MX_DMA_Init();
  MX_ADC1_Init();
  MX_DAC1_Init();
  MX_TIM6_Init();
  MX_USART2_UART_Init();
  MX_TIM2_Init();
  MX_TIM3_Init();
  /* USER CODE BEGIN 2 */

    /* Encoder/PWMs */
  HAL_GPIO_WritePin(GPIOB, GPIO_PIN_0, GPIO_PIN_SET);
  HAL_TIM_PWM_Start(&htim3, TIM_CHANNEL_1);  // PB4, PWM1
  __HAL_TIM_SET_COMPARE(&htim3, TIM_CHANNEL_1, 2475);
  HAL_TIM_PWM_Start(&htim2, TIM_CHANNEL_3);  // PB10, PWM2
  __HAL_TIM_SET_COMPARE(&htim2, TIM_CHANNEL_3, 2630);

  /* ADC + DAC Startup */
  HAL_DAC_Start(&hdac1, DAC_CHANNEL_1);
  HAL_ADCEx_Calibration_Start(&hadc1, ADC_SINGLE_ENDED);
  HAL_ADC_Start_DMA(&hadc1, (uint32_t*)adcBuffer, ADC_BUF_LEN);
  HAL_TIM_Base_Start_IT(&htim6);

  /* USER CODE END 2 */

  /* Infinite loop */
  /* USER CODE BEGIN WHILE */

while (1) /* this loop handles chaning PWM via rotary encoder */
{
  static uint8_t lastA = 0;
  static uint8_t initialized = 0;
  static uint32_t lastStepTime = 0; // all for determining encoder state and debouncing

  // Read encoder pins, active high with pull-downs, so SET means 1, RESET means 0
  uint8_t A = (HAL_GPIO_ReadPin(GPIOC, GPIO_PIN_7) == GPIO_PIN_SET) ? 1 : 0;
  uint8_t B = (HAL_GPIO_ReadPin(GPIOB, GPIO_PIN_6) == GPIO_PIN_SET) ? 1 : 0;

  if (!initialized)
  {
    lastA = A; // initialize lastA to current state to avoid false step detection on startup
    initialized = 1;
  }

  if ((HAL_GetTick() - lastStepTime) > 50) // debounce
  {
    if ((lastA == 0) && (A == 1)) // detect rising edge on A
    {
      lastStepTime = HAL_GetTick();

      if (B == 0) // determines CW vs CCW based on state of B when A rises
      {
        if (freqInd < 15) freqInd++; //increase
      }
      else
      {
        if (freqInd > 0) freqInd--; //decrease
      }

      __HAL_TIM_SET_COMPARE(&htim3, TIM_CHANNEL_1, pwm1Dutys[freqInd]);
      __HAL_TIM_SET_COMPARE(&htim2, TIM_CHANNEL_3, pwm2Dutys[freqInd]); // update PWM duty cycles based on new index
    }
  }

  lastA = A;
}

    /* USER CODE END WHILE */

}


void SystemClock_Config(void) // Generated by CubeMX, sets up system clock
{
  RCC_OscInitTypeDef RCC_OscInitStruct = {0};
  RCC_ClkInitTypeDef RCC_ClkInitStruct = {0};
  RCC_PeriphCLKInitTypeDef PeriphClkInit = {0};

  /** Initializes the RCC Oscillators according to the specified parameters
  * in the RCC_OscInitTypeDef structure.
  */
  RCC_OscInitStruct.OscillatorType = RCC_OSCILLATORTYPE_HSI;
  RCC_OscInitStruct.HSIState = RCC_HSI_ON;
  RCC_OscInitStruct.HSICalibrationValue = RCC_HSICALIBRATION_DEFAULT;
  RCC_OscInitStruct.PLL.PLLState = RCC_PLL_ON;
  RCC_OscInitStruct.PLL.PLLSource = RCC_PLLSOURCE_HSI;
  RCC_OscInitStruct.PLL.PLLMUL = RCC_PLL_MUL9;
  RCC_OscInitStruct.PLL.PREDIV = RCC_PREDIV_DIV1;
  if (HAL_RCC_OscConfig(&RCC_OscInitStruct) != HAL_OK)
  {
    Error_Handler();
  }

  /** Initializes the CPU, AHB and APB buses clocks
  */
  RCC_ClkInitStruct.ClockType = RCC_CLOCKTYPE_HCLK|RCC_CLOCKTYPE_SYSCLK
                              |RCC_CLOCKTYPE_PCLK1|RCC_CLOCKTYPE_PCLK2;
  RCC_ClkInitStruct.SYSCLKSource = RCC_SYSCLKSOURCE_PLLCLK;
  RCC_ClkInitStruct.AHBCLKDivider = RCC_SYSCLK_DIV1;
  RCC_ClkInitStruct.APB1CLKDivider = RCC_HCLK_DIV2;
  RCC_ClkInitStruct.APB2CLKDivider = RCC_HCLK_DIV1;

  if (HAL_RCC_ClockConfig(&RCC_ClkInitStruct, FLASH_LATENCY_2) != HAL_OK)
  {
    Error_Handler();
  }
  PeriphClkInit.PeriphClockSelection = RCC_PERIPHCLK_USART2|RCC_PERIPHCLK_ADC12
                              |RCC_PERIPHCLK_TIM2|RCC_PERIPHCLK_TIM34;
  PeriphClkInit.Usart2ClockSelection = RCC_USART2CLKSOURCE_PCLK1;
  PeriphClkInit.Adc12ClockSelection = RCC_ADC12PLLCLK_DIV1;
  PeriphClkInit.Tim2ClockSelection = RCC_TIM2CLK_HCLK;
  PeriphClkInit.Tim34ClockSelection = RCC_TIM34CLK_HCLK;
  if (HAL_RCCEx_PeriphCLKConfig(&PeriphClkInit) != HAL_OK)
  {
    Error_Handler();
  }
}


/* USER CODE BEGIN 4 */


void HAL_ADC_ConvHalfCpltCallback(ADC_HandleTypeDef* hadc) // This callback is called when the ADC DMA has filled the first half of the buffer, since we use two channels it leaves time to get both aux + mic samples before mixing
{
  if (hadc->Instance == ADC1)
  {
    halfCount++; // debugging
    adcHalfReady = 1;
  }
}

void HAL_ADC_ConvCpltCallback(ADC_HandleTypeDef* hadc) // Same as above, but the second half
{
  if (hadc->Instance == ADC1)
  {
    fullCount++; // debugging
    adcFullReady = 1;
  }
}

void HAL_TIM_PeriodElapsedCallback(TIM_HandleTypeDef *htim) // The main audio processing happens in this timer function
{
  if (htim->Instance == TIM6) // 44.1kHz timer set up in CubeMX
  {

    if (HAL_GPIO_ReadPin(GPIOB, GPIO_PIN_5) == GPIO_PIN_RESET) //knife switch, if closed, software mute by outputting DC offset only
    {
  // Knife switch active: mute audio in software
      HAL_DAC_SetValue(&hdac1, DAC_CHANNEL_1, DAC_ALIGN_12B_R, 2048);
      return;
    }

    uint32_t dmaRemaining = __HAL_DMA_GET_COUNTER(hadc1.DMA_Handle); // Determine where in ADC buffer we are writing at, to not overwrite unread samples
    uint32_t writeIndex = ADC_BUF_LEN - dmaRemaining; // Tells us the index of the most recent sample
  
    if (writeIndex >= ADC_BUF_LEN) // Once it hits 512, it wraps back to 0
    {
      writeIndex = 0;
    }

    uint32_t readIndex; // We want to read the sample that was just fully written, which is 2 samples (mic + aux) behind the current write index

    if (writeIndex >= 2) 
    {
      readIndex = writeIndex - 2; // Read the sample that was just fully written
    }
    else
    {
      readIndex = ADC_BUF_LEN - 2;
    }

    // Ensure readIndex points to mic sample, even index
    if (readIndex % 2 != 0)
    {
      readIndex--; // ALWAYS starts with mic sample, just in case
    }

    uint16_t micRaw = adcBuffer[readIndex];       // PA0
    uint16_t auxRaw = adcBuffer[readIndex + 1];   // PA1

    int32_t micAC = (int32_t)micRaw - 2056; // removing DC offsets
    int32_t auxAC = (int32_t)auxRaw - 2033; 

    // mic + aux gain
    int32_t micScaled = micAC;
    int32_t auxScaled = auxAC / 4;

    int32_t mixedAC = micScaled + auxScaled;
    int32_t dacOut = 2048 + mixedAC; // adding back DC offset for output

    if (dacOut < 0) dacOut = 0;
    if (dacOut > 4095) dacOut = 4095; // clipping

    HAL_DAC_SetValue(&hdac1, DAC_CHANNEL_1, DAC_ALIGN_12B_R, (uint32_t)dacOut); // DAC Output on PA4
  }
}

/* USER CODE END 4 */


void Error_Handler(void) // Generated by CubeMX, called on error
{
  /* USER CODE BEGIN Error_Handler_Debug */
  /* User can add his own implementation to report the HAL error return state */
  __disable_irq();
  while (1)
  {
  }
  /* USER CODE END Error_Handler_Debug */
}
#ifdef USE_FULL_ASSERT
/**
  * @brief  Reports the name of the source file and the source line number
  *         where the assert_param error has occurred.
  * @param  file: pointer to the source file name
  * @param  line: assert_param error line source number
  * @retval None
  */
void assert_failed(uint8_t *file, uint32_t line) // Generated by CubeMX
{
  /* USER CODE BEGIN 6 */
  /* User can add his own implementation to report the file name and line number,
     ex: printf("Wrong parameters value: file %s on line %d\r\n", file, line) */
  /* USER CODE END 6 */
}
#endif /* USE_FULL_ASSERT */
